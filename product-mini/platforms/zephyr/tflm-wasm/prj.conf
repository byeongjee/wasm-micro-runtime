## CMakeLists.txt
```
# Copyright (C) 2019 Intel Corporation.  All rights reserved.
# SPDX-License-Identifier: Apache-2.0 WITH LLVM-exception

cmake_minimum_required(VERSION 3.8.2)

find_package(Zephyr REQUIRED HINTS $ENV{ZEPHYR_BASE})
project(wamr)

enable_language (ASM)

set (WAMR_BUILD_PLATFORM "zephyr")

set (WAMR_BUILD_TARGET "THUMBV7_VFP")
set (WAMR_BUILD_INTERP 1)
set (WAMR_BUILD_JIT 0)
set (WAMR_BUILD_AOT 1)
set (WAMR_BUILD_FAST_JIT 0)
set (WAMR_BUILD_LIBC_BUILTIN 1)
set (WAMR_BUILD_LIBC_WASI 0)
set (WAMR_BUILD_LIB_PTHREAD 0)
set (WAMR_BUILD_GLOBAL_HEAP_POOL 1)
set (WAMR_BUILD_GLOBAL_HEAP_SIZE 1572864)


set (WAMR_ROOT_DIR ${CMAKE_CURRENT_SOURCE_DIR}/../../../..)

include (${WAMR_ROOT_DIR}/build-scripts/runtime_lib.cmake)
include (${WAMR_ROOT_DIR}/core/shared/platform/common/math/platform_api_math.cmake)

zephyr_library_include_directories(${ZEPHYR_BASE}/../modules/hal/ambiq)

target_sources(app PRIVATE
               ${WAMR_RUNTIME_LIB_SOURCE}
               src/main.c)

target_compile_options(app PRIVATE -static -mthumb -mcpu=cortex-m4 -mfloat-abi=hard -mfpu=fpv4-sp-d16 -O3)
```

## prj.conf
```kconfig
# Copyright (C) 2019 Intel Corporation.  All rights reserved.
# SPDX-License-Identifier: Apache-2.0 WITH LLVM-exception

CONFIG_PRINTK=y
CONFIG_LOG=y
CONFIG_LOG_DEFAULT_LEVEL=4
CONFIG_KERNEL_LOG_LEVEL_INF=y
CONFIG_LOG_MODE_IMMEDIATE=y
CONFIG_NEWLIB_LIBC=y
CONFIG_FPU=y
CONFIG_FPU_SHARING=y
CONFIG_FP_HARDABI=y

# CONFIG_ASSERT=y
# CONFIG_DEBUG=y
# CONFIG_STACK_SENTINEL=y
```

## src/main.c
```c
/*
 * Copyright (C) 2019 Intel Corporation.  All rights reserved.
 * SPDX-License-Identifier: Apache-2.0 WITH LLVM-exception
 */

#include <stdlib.h>
#include <string.h>
#include "bh_platform.h"
#include "bh_assert.h"
#include "bh_log.h"
#include "wasm_export.h"
#include "test_wasm.h"
#include "am_mcu_apollo.h"

#define CONFIG_APP_STACK_SIZE 256000
#define CONFIG_APP_HEAP_SIZE 1228800
#define CONFIG_MAIN_THREAD_STACK_SIZE 256000

static int app_argc;
static char **app_argv;

void
gpio_toggle(wasm_exec_env_t exec_env)
{
    am_hal_gpio_state_write(22, AM_HAL_GPIO_OUTPUT_TOGGLE);
}

void
delay(wasm_exec_env_t exec_env, int ms)
{
    am_hal_gpio_state_write(22, AM_HAL_GPIO_OUTPUT_TOGGLE);
}
/**
 * Find the unique main function from a WASM module instance
 * and execute that function.
 *
 * @param module_inst the WASM module instance
 * @param argc the number of arguments
 * @param argv the arguments array
 *
 * @return true if the main function is called, false otherwise.
 */
bool
wasm_application_execute_main(wasm_module_inst_t module_inst, int argc,
                              char *argv[]);

static void *
app_instance_main(wasm_module_inst_t module_inst)
{
    const char *exception;
    wasm_function_inst_t func;
    wasm_exec_env_t exec_env;
    unsigned argv[2] = { 0 };

    if (wasm_runtime_lookup_function(module_inst, "main")
        || wasm_runtime_lookup_function(module_inst, "__main_argc_argv")) {
        LOG_VERBOSE("Calling main function\n");
        wasm_application_execute_main(module_inst, app_argc, app_argv);
    }
    else if ((func = wasm_runtime_lookup_function(module_inst, "app_main"))) {
        exec_env =
            wasm_runtime_create_exec_env(module_inst, CONFIG_APP_HEAP_SIZE);
        if (!exec_env) {
            os_printf("Create exec env failed\n");
            return NULL;
        }

        LOG_VERBOSE("Calling app_main function\n");
        wasm_runtime_call_wasm(exec_env, func, 0, argv);

        if (!wasm_runtime_get_exception(module_inst)) {
            os_printf("result: 0x%x\n", argv[0]);
        }

        wasm_runtime_destroy_exec_env(exec_env);
    }
    else {
        os_printf("Failed to lookup function main or app_main to call\n");
        return NULL;
    }

    if ((exception = wasm_runtime_get_exception(module_inst)))
        os_printf("%s\n", exception);

    return NULL;
}

void
iwasm_main(void *arg1, void *arg2, void *arg3)
{
    int start, module_init, module_load, finish_main, end;
    start = k_uptime_get_32();
    uint8 *wasm_file_buf = NULL;
    uint32 wasm_file_size;
    wasm_module_t wasm_module = NULL;
    wasm_module_inst_t wasm_module_inst = NULL;
    RuntimeInitArgs init_args;
    char error_buf[128];
#if WASM_ENABLE_LOG != 0
    int log_verbose_level = 2;
#endif

    (void)arg1;
    (void)arg2;
    (void)arg3;

    memset(&init_args, 0, sizeof(RuntimeInitArgs));

#if WASM_ENABLE_GLOBAL_HEAP_POOL != 0
    init_args.mem_alloc_type = Alloc_With_Pool;
    init_args.mem_alloc_option.pool.heap_buf = global_heap_buf;
    init_args.mem_alloc_option.pool.heap_size = sizeof(global_heap_buf);
#elif (defined(CONFIG_COMMON_LIBC_MALLOC)            \
       && CONFIG_COMMON_LIBC_MALLOC_ARENA_SIZE != 0) \
    || defined(CONFIG_NEWLIB_LIBC)
    init_args.mem_alloc_type = Alloc_With_System_Allocator;
#else
#error "memory allocation scheme is not defined."
#endif

    /* initialize runtime environment */
    if (!wasm_runtime_full_init(&init_args)) {
        printf("Init runtime environment failed.\n");
        return;
    }

#if WASM_ENABLE_LOG != 0
    bh_log_set_verbose_level(log_verbose_level);
#endif

    /* register native symbols */
    static NativeSymbol native_symbols[] = { { "gpio_toggle", gpio_toggle, "()"

                                             },
                                             {
                                                 "delay",
                                                 delay,
                                                 "(i)",
                                             } };
    int n_native_symbols = sizeof(native_symbols) / sizeof(NativeSymbol);

    if (!wasm_runtime_register_natives("env", native_symbols,
                                       n_native_symbols)) {
        printf("Register natives failed.\n");
        goto fail1;
    }

    /* load WASM byte buffer from byte buffer of include file */
    wasm_file_buf = (uint8 *)wasm_aot_file;
    wasm_file_size = sizeof(wasm_aot_file);

    printk("wasm file size: %d\n", wasm_file_size);

    /* load WASM module */
    if (!(wasm_module = wasm_runtime_load(wasm_file_buf, wasm_file_size,
                                          error_buf, sizeof(error_buf)))) {
        printf("%s\n", error_buf);
        goto fail1;
    }

    module_load = k_uptime_get_32();
    printf("elapsed (module load): %d\n", (module_load - start));

    printk("heap size: %d\n", CONFIG_APP_HEAP_SIZE);
    printk("stack size: %d\n", CONFIG_APP_STACK_SIZE);
    printk("clock frequency: %d\n", sys_clock_hw_cycles_per_sec());

    /* instantiate the module */
    if (!(wasm_module_inst = wasm_runtime_instantiate(
              wasm_module, CONFIG_APP_STACK_SIZE, CONFIG_APP_HEAP_SIZE,
              error_buf, sizeof(error_buf)))) {
        printf("%s\n", error_buf);
        goto fail2;
    }

    module_init = k_uptime_get_32();
    printf("elapsed (module instantiation): %d\n", (module_init - module_load));
    /* invoke the main function */

    /* pin 23 measures the time between app instance main */
    am_hal_gpio_state_write(23, AM_HAL_GPIO_OUTPUT_TOGGLE);
    app_instance_main(wasm_module_inst);
    am_hal_gpio_state_write(23, AM_HAL_GPIO_OUTPUT_TOGGLE);

    finish_main = k_uptime_get_32();
    printf("elapsed (finish main): %d\n", (finish_main - module_init));

    /* destroy the module instance */
    wasm_runtime_deinstantiate(wasm_module_inst);

fail2:
    /* unload the module */
    wasm_runtime_unload(wasm_module);

fail1:
    /* destroy runtime environment */
    wasm_runtime_destroy();

    end = k_uptime_get_32();

    printf("elapsed: %d\n", (end - start));
}

#define MAIN_THREAD_STACK_SIZE (CONFIG_MAIN_THREAD_STACK_SIZE)
#define MAIN_THREAD_PRIORITY -1

K_THREAD_STACK_DEFINE(iwasm_main_thread_stack, MAIN_THREAD_STACK_SIZE);
static struct k_thread iwasm_main_thread;

bool
iwasm_init(void)
{
    k_tid_t tid = k_thread_create(
        &iwasm_main_thread, iwasm_main_thread_stack, MAIN_THREAD_STACK_SIZE,
        iwasm_main, NULL, NULL, NULL, MAIN_THREAD_PRIORITY, 0, K_NO_WAIT);
    return tid ? true : false;
}
int
main(void)
{
    am_hal_cachectrl_config_t am_hal_cachectrl_user = {
        .bLRU = 0,
        .eDescript = AM_HAL_CACHECTRL_DESCR_1WAY_128B_4096E,
        .eMode = AM_HAL_CACHECTRL_CONFIG_MODE_INSTR_DATA,
    };

    am_hal_cachectrl_config(&am_hal_cachectrl_user);
    am_hal_cachectrl_enable();

    uint32_t status;

    am_hal_pwrctrl_low_power_init();
    status = am_hal_pwrctrl_mcu_mode_select(
        AM_HAL_PWRCTRL_MCU_MODE_HIGH_PERFORMANCE);

    if (status == AM_HAL_STATUS_SUCCESS) {
        printk("MCU mode selected successfully\n");
    }
    else {
        printk("Failed to select MCU mode: 0x%08x\n", status);
    }

    //
    // Initialize GPIOs
    //
    am_hal_gpio_pincfg_t am_hal_gpio_pincfg_output = AM_HAL_GPIO_PINCFG_OUTPUT;
    am_hal_gpio_pinconfig(22, am_hal_gpio_pincfg_output);
    am_hal_gpio_pinconfig(23, am_hal_gpio_pincfg_output);

    iwasm_init();
    return 0;
}
```
